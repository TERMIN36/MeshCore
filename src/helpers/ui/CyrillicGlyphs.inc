static const uint8_t CYR_OLED_H = 10;
static const uint8_t CYR_OLED_BASE = 7;
static const uint8_t CYR_OLED_ADV[66] PROGMEM = {
  0x06, 0x06, 0x06, 0x06, 0x06, 0x06, 0x06, 0x06, 0x06, 0x06, 0x06, 0x06, 0x06, 0x06, 0x06, 0x06, 0x06, 0x06, 0x06, 0x06, 0x06, 0x06, 0x06, 0x06, 0x06, 0x06, 0x06, 0x06, 0x06, 0x06, 0x06, 0x06, 0x06,
  0x06, 0x06, 0x06, 0x06, 0x06, 0x06, 0x06, 0x06, 0x06, 0x06, 0x06, 0x06, 0x06, 0x06, 0x06, 0x06, 0x06, 0x06, 0x06, 0x06, 0x06, 0x06, 0x06, 0x06, 0x06, 0x06, 0x06, 0x06, 0x06, 0x06, 0x06, 0x06, 0x06
};
static const uint16_t CYR_OLED_OFF[66] PROGMEM = {
  0x0000, 0x000A, 0x0014, 0x001E, 0x0028, 0x0032, 0x003C, 0x0046, 0x0050, 0x005A, 0x0064, 0x006E,
  0x0078, 0x0082, 0x008C, 0x0096, 0x00A0, 0x00AA, 0x00B4, 0x00BE, 0x00C8, 0x00D2, 0x00DC, 0x00E6,
  0x00F0, 0x00FA, 0x0104, 0x010E, 0x0118, 0x0122, 0x012C, 0x0136, 0x0140, 0x014A, 0x0154, 0x015E,
  0x0168, 0x0172, 0x017C, 0x0186, 0x0190, 0x019A, 0x01A4, 0x01AE, 0x01B8, 0x01C2, 0x01CC, 0x01D6,
  0x01E0, 0x01EA, 0x01F4, 0x01FE, 0x0208, 0x0212, 0x021C, 0x0226, 0x0230, 0x023A, 0x0244, 0x024E,
  0x0258, 0x0262, 0x026C, 0x0276, 0x0280, 0x028A
};
static const uint8_t CYR_OLED_BITS[660] PROGMEM = {
  0x00, 0x70, 0x88, 0x88, 0xF8, 0x88, 0x88, 0x88, 0x00, 0x00, 0x00, 0xF8, 0x80, 0x80, 0xF0, 0x88,
  0x88, 0xF0, 0x00, 0x00, 0x00, 0xF0, 0x88, 0x88, 0xF0, 0x88, 0x88, 0xF0, 0x00, 0x00, 0x00, 0xF8,
  0x80, 0x80, 0x80, 0x80, 0x80, 0x80, 0x00, 0x00, 0x00, 0x78, 0x48, 0x48, 0x48, 0x48, 0x48, 0xF8,
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  0x80, 0x70, 0x00, 0x00
};

static const uint8_t CYR_TFT_H = 19;
static const uint8_t CYR_TFT_BASE = 15;
static const uint8_t CYR_TFT_ADV[66] PROGMEM = {
  0x0C, 0x0B, 0x0B, 0x09, 0x0B, 0x0B, 0x0F, 0x0A, 0x0C, 0x0C, 0x0A, 0x0B, 0x0D, 0x0C, 0x0C, 0x0C, 0x0B, 0x0C, 0x0A, 0x0B, 0x0C, 0x0B, 0x0C, 0x0B, 0x0F, 0x0F, 0x0D, 0x0E, 0x0B, 0x0C, 0x10, 0x0C, 0x0B, 0x09, 0x09, 0x09, 0x06, 0x09, 0x09, 0x0C, 0x07, 0x09, 0x09, 0x08, 0x09, 0x0B, 0x09, 0x09, 0x09, 0x09, 0x08, 0x08, 0x08, 0x0D, 0x08, 0x09, 0x08, 0x0D, 0x0D, 0x0A, 0x0C, 0x08, 0x08, 0x0C, 0x09, 0x09
};
static const uint16_t CYR_TFT_OFF[66] PROGMEM = {
  0x0000, 0x0026, 0x004C, 0x0072, 0x0098, 0x00BE, 0x00E4, 0x010A, 0x0130, 0x0156, 0x017C, 0x01A2,
  0x01C8, 0x01EE, 0x0214, 0x023A, 0x0260, 0x0286, 0x02AC, 0x02D2, 0x02F8, 0x031E, 0x0344, 0x036A,
  0x0390, 0x03B6, 0x03DC, 0x0402, 0x0428, 0x044E, 0x0474, 0x049A, 0x04C0, 0x04E6, 0x050C, 0x0532,
  0x0558, 0x056B, 0x0591, 0x05B7, 0x05DD, 0x05F0, 0x0616, 0x063C, 0x064F, 0x0675, 0x069B, 0x06C1,
  0x06E7, 0x070D, 0x0733, 0x0746, 0x0759, 0x076C, 0x0792, 0x07A5, 0x07CB, 0x07DE, 0x0804, 0x082A,
  0x0850, 0x0876, 0x0889, 0x089C, 0x08C2, 0x08E8
};
static const uint8_t CYR_TFT_BITS[2318] PROGMEM = {
  0x00, 0x00, 0x00, 0x00, 0x00, 0x00, 0x06, 0x00, 0x07, 0x00, 0x0F, 0x00, 0x0D, 0x00, 0x09, 0x80,
  0x18, 0x80, 0x10, 0xC0, 0x1F, 0xC0, 0x30, 0x40, 0x20, 0x60, 0x20, 0x60, 0x60, 0x30, 0x00, 0x00,
  0x00, 0x00, 0x00, 0x00, 0x00, 0x00, 0x00, 0x00, 0x00, 0x00, 0x00, 0x00, 0x7F, 0x80, 0x60, 0x00,
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  0x41, 0x00, 0x62, 0x00, 0x1C, 0x00, 0x00, 0x00, 0x00, 0x00, 0x00, 0x00, 0x00, 0x00
};

static const uint8_t CYR_TFT2_H = 28;
static const uint8_t CYR_TFT2_BASE = 22;
static const uint8_t CYR_TFT2_ADV[66] PROGMEM = {
  0x12, 0x10, 0x10, 0x0D, 0x10, 0x10, 0x17, 0x0F, 0x11, 0x11, 0x0E, 0x10, 0x14, 0x11, 0x13, 0x11, 0x10, 0x11, 0x0F, 0x10, 0x12, 0x10, 0x12, 0x10, 0x16, 0x17, 0x13, 0x15, 0x10, 0x11, 0x18, 0x11, 0x10, 0x0D, 0x0E, 0x0D, 0x09, 0x0E, 0x0D, 0x12, 0x0B, 0x0D, 0x0D, 0x0B, 0x0E, 0x11, 0x0D, 0x0D, 0x0D, 0x0D, 0x0C, 0x0B, 0x0C, 0x14, 0x0C, 0x0E, 0x0D, 0x13, 0x14, 0x0F, 0x11, 0x0D, 0x0C, 0x12, 0x0D, 0x0D
};
static const uint16_t CYR_TFT2_OFF[66] PROGMEM = {
  0x0000, 0x0054, 0x008C, 0x00C4, 0x00FC, 0x0134, 0x016C, 0x01C0, 0x01F8, 0x024C, 0x02A0, 0x02D8,
  0x0310, 0x0364, 0x03B8, 0x040C, 0x0460, 0x0498, 0x04EC, 0x0524, 0x055C, 0x05B0, 0x05E8, 0x063C,
  0x0674, 0x06C8, 0x071C, 0x0770, 0x07C4, 0x07FC, 0x0850, 0x08A4, 0x08F8, 0x0930, 0x0968, 0x09A0,
  0x09D8, 0x0A10, 0x0A48, 0x0A80, 0x0AD4, 0x0B0C, 0x0B44, 0x0B7C, 0x0BB4, 0x0BEC, 0x0C40, 0x0C78,
  0x0CB0, 0x0CE8, 0x0D20, 0x0D58, 0x0D90, 0x0DC8, 0x0E1C, 0x0E54, 0x0E8C, 0x0EC4, 0x0F18, 0x0F6C,
  0x0FA4, 0x0FF8, 0x1030, 0x1068, 0x10BC, 0x10F4
};
static const uint8_t CYR_TFT2_BITS[4396] PROGMEM = {
  0x00, 0x00, 0x00, 0x00, 0x00, 0x00, 0x00, 0x00, 0x00, 0x00, 0x00, 0x00, 0x00, 0x00, 0x00, 0x01,
  0xC0, 0x00, 0x01, 0xE0, 0x00, 0x01, 0xE0, 0x00, 0x03, 0x60, 0x00, 0x03, 0x30, 0x00, 0x07, 0x30,
  0x00, 0x06, 0x38, 0x00, 0x06, 0x18, 0x00, 0x0C, 0x1C, 0x00, 0x0C, 0x0C, 0x00, 0x1F, 0xFC, 0x00,
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  0x00, 0x00, 0x00, 0x00, 0x00, 0x00, 0x00, 0x00, 0x00, 0x00, 0x00, 0x00
};

static const uint8_t CYR_EINK_H = 21;
static const uint8_t CYR_EINK_BASE = 16;
static const uint8_t CYR_EINK_ADV[66] PROGMEM = {
  0x0D, 0x0C, 0x0D, 0x0A, 0x0D, 0x0D, 0x12, 0x0B, 0x0E, 0x0E, 0x0B, 0x0C, 0x10, 0x0E, 0x0F, 0x0E, 0x0D, 0x0E, 0x0C, 0x0C, 0x0E, 0x0D, 0x0E, 0x0D, 0x11, 0x12, 0x0F, 0x11, 0x0C, 0x0E, 0x13, 0x0E, 0x0D,
  0x0B, 0x0B, 0x0A, 0x07, 0x0B, 0x0B, 0x0E, 0x09, 0x0B, 0x0B, 0x08, 0x0B, 0x0D, 0x0B, 0x0B, 0x0A, 0x0B, 0x0A, 0x09, 0x0A, 0x10, 0x0A, 0x0B, 0x0A, 0x0F, 0x10, 0x0C, 0x0E, 0x0A, 0x0A, 0x0E, 0x0A, 0x0B
};
static const uint16_t CYR_EINK_OFF[66] PROGMEM = {
  0x0000, 0x002A, 0x0054, 0x007E, 0x00A8, 0x00D2, 0x00FC, 0x013B, 0x0165, 0x018F, 0x01B9, 0x01E3,
  0x020D, 0x0237, 0x0261, 0x028B, 0x02B5, 0x02DF, 0x0309, 0x0333, 0x035D, 0x0387, 0x03B1, 0x03DB,
  0x0405, 0x0444, 0x0483, 0x04AD, 0x04EC, 0x0516, 0x0540, 0x057F, 0x05A9, 0x05D3, 0x05FD, 0x0627,
  0x0651, 0x0666, 0x0690, 0x06BA, 0x06E4, 0x070E, 0x0738, 0x0762, 0x0777, 0x07A1, 0x07CB, 0x07F5,
  0x081F, 0x0849, 0x0873, 0x089D, 0x08C7, 0x08F1, 0x091B, 0x0945, 0x096F, 0x0999, 0x09C3, 0x09ED,
  0x0A17, 0x0A41, 0x0A6B, 0x0A95, 0x0ABF, 0x0AE9
};
static const uint8_t CYR_EINK_BITS[2835] PROGMEM = {
  0x00, 0x00, 0x00, 0x00, 0x00, 0x00, 0x00, 0x00, 0x07, 0x00, 0x05, 0x00, 0x0D, 0x80, 0x0D, 0x80,
  0x08, 0x80, 0x18, 0xC0, 0x18, 0xC0, 0x30, 0x60, 0x3F, 0xE0, 0x20, 0x30, 0x60, 0x30, 0x40, 0x10,
  0xC0, 0x18, 0x00, 0x00, 0x00, 0x00, 0x00, 0x00, 0x00, 0x00, 0x00, 0x00, 0x00, 0x00, 0x00, 0x00,
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  0x00, 0x00, 0x00
};

static const uint8_t CYR_EINK2_H = 29;
static const uint8_t CYR_EINK2_BASE = 23;
static const uint8_t CYR_EINK2_ADV[66] PROGMEM = {
  0x13, 0x13, 0x13, 0x0F, 0x13, 0x11, 0x19, 0x10, 0x13, 0x13, 0x10, 0x12, 0x16, 0x13, 0x14, 0x13, 0x11, 0x13, 0x10, 0x10, 0x16, 0x11, 0x13, 0x12, 0x1A, 0x1B, 0x17, 0x19, 0x13, 0x13, 0x1B, 0x13, 0x11,
  0x0E, 0x10, 0x10, 0x0B, 0x11, 0x0E, 0x13, 0x0D, 0x10, 0x10, 0x0D, 0x11, 0x13, 0x10, 0x10, 0x10, 0x10, 0x0E, 0x0D, 0x0F, 0x17, 0x0E, 0x10, 0x0F, 0x16, 0x16, 0x13, 0x16, 0x10, 0x0E, 0x16, 0x10, 0x0E
};
static const uint16_t CYR_EINK2_OFF[66] PROGMEM = {
  0x0000, 0x0057, 0x00AE, 0x0105, 0x013F, 0x0196, 0x01ED, 0x0261, 0x029B, 0x02F2, 0x0349, 0x0383,
  0x03DA, 0x0431, 0x0488, 0x04DF, 0x0536, 0x058D, 0x05E4, 0x061E, 0x0658, 0x06AF, 0x0706, 0x075D,
  0x07B4, 0x0828, 0x089C, 0x08F3, 0x0967, 0x09BE, 0x0A15, 0x0A89, 0x0AE0, 0x0B37, 0x0B71, 0x0BAB,
  0x0BE5, 0x0C1F, 0x0C76, 0x0CB0, 0x0D07, 0x0D41, 0x0D7B, 0x0DB5, 0x0DEF, 0x0E46, 0x0E9D, 0x0ED7,
  0x0F11, 0x0F4B, 0x0F85, 0x0FBF, 0x0FF9, 0x1033, 0x108A, 0x10C4, 0x10FE, 0x1138, 0x118F, 0x11E6,
  0x123D, 0x1294, 0x12CE, 0x1308, 0x135F, 0x1399
};
static const uint8_t CYR_EINK2_BITS[5075] PROGMEM = {
  0x00, 0x00, 0x00, 0x00, 0x00, 0x00, 0x00, 0x00, 0x00, 0x00, 0x00, 0x00, 0x00, 0x00, 0x00, 0x00,
  0x00, 0x00, 0x01, 0xF0, 0x00, 0x01, 0xF0, 0x00, 0x03, 0xF8, 0x00, 0x03, 0xB8, 0x00, 0x03, 0xB8,
  0x00, 0x07, 0xBC, 0x00, 0x07, 0x1C, 0x00, 0x07, 0x1C, 0x00, 0x0F, 0x1E, 0x00, 0x0E, 0x0E, 0x00,
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  0x00, 0x00, 0x00
};
